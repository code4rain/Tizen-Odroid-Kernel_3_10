## drivers/staging/argos/Kconfig
```kconfig
#
# Network Throughput base QoS using argos daemon
#
menu "Network Throughput base QoS using argos daemon"
	depends on PM

config ARGOS
	bool "Network extended QoS Support"
	depens on PM
	---help---
	This option enables network extended QoS support with usermode daemon - argosd
	. This is helpful to guaruntee specific device drivers throughput like WIFI,
	P2P, MODEM, and so on.
```
